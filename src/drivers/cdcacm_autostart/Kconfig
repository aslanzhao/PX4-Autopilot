## src/modules/fmav_att_control/Kconfig
```kconfig
menuconfig MODULES_FMAV_ATT_CONTROL
	bool "fmav_att_control"
	default n
	---help---
		Enable support for fmav_att_control

menuconfig USER_FMAV_ATT_CONTROL
	bool "fmav_att_control running as userspace module"
	default n
	depends on BOARD_PROTECTED && MODULES_MC_ATT_CONTROL
	---help---
		Put fmav_att_control in userspace memory
```

## src/modules/fmav_autotune_attitude_control/Kconfig
```kconfig
menuconfig MODULES_FMAV_AUTOTUNE_ATTITUDE_CONTROL
	bool "fmav_autotune_attitude_control"
	default n
	---help---
		Enable support for fmav_autotune_attitude_control
```

## src/modules/fmav_hover_thrust_estimator/Kconfig
```kconfig
menuconfig MODULES_FMAV_HOVER_THRUST_ESTIMATOR
	bool "fmav_mc_hover_thrust_estimator"
	default n
	---help---
		Enable support for fmav_hover_thrust_estimator

menuconfig USER_FMAV_HOVER_THRUST_ESTIMATOR
	bool "fmav_hover_thrust_estimator running as userspace module"
	default y
	depends on BOARD_PROTECTED && MODULES_FMAV_HOVER_THRUST_ESTIMATOR
	---help---
		Put fmav_hover_thrust_estimator in userspace memory
```

## src/modules/fmav_pos_control/Kconfig
```kconfig
menuconfig MODULES_FMAV_POS_CONTROL
	bool "fmav_pos_control"
	default n
	---help---
		Enable support for fmav_pos_control

menuconfig USER_FMAV_POS_CONTROL
	bool "fmav_pos_control running as userspace module"
	default y
	depends on BOARD_PROTECTED && MODULES_MAV_POS_CONTROL
	---help---
		Put fmav_pos_control in userspace memory
```

## src/modules/fmav_rate_control/Kconfig
```kconfig
menuconfig MODULES_FMAV_RATE_CONTROL
	bool "fmav_rate_control"
	default n
	---help---
		Enable support for fmav_rate_control

menuconfig USER_FMAV_RATE_CONTROL
	bool "fmav_rate_control running as userspace module"
	default n
	depends on BOARD_PROTECTED && MODULES_FMAV_RATE_CONTROL
	---help---
		Put fmav_rate_control in userspace memory
```

## src/modules/manual_servo_control/Kconfig
```kconfig
menuconfig MODULES_MANUAL_SERVO_CONTROL
	bool "manual_servo_control"
	default n
	---help---
		Enable support for manual_servo_control

menuconfig USER_MANUAL_SERVO_CONTROL
	bool "manual_servo_control running as userspace module"
	default n
	depends on BOARD_PROTECTED && MODULES_MANUAL_SERVO_CONTROL
	---help---
		Put manual_servo_control in userspace memory
```
